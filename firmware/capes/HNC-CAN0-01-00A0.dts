/*
* Copyright (C) 2013 Martin Gysel <me@bearsh.org>
*
* This program is free software; you can redistribute it and/or modify
* it under the terms of the GNU General Public License version 2 as
* published by the Free Software Foundation.
*/
/dts-v1/;
/plugin/;


/ {
	compatible = "ti,beaglebone", "ti,beaglebone-black";
	part-number = "HNC-CAN0-01";
	version = "00A0";

	fragment@0 {
		target = <&am33xx_pinmux>;
		__overlay__ {
			bone_serl_01_dcan0_pins: bone_serl_01_dcan0_pins {
				pinctrl-single,pins = <
					0x178 0x02      /* uart1_ctsn.d_can0_tx", OUTPUT | MODE2 */
					0x17c 0x32      /* uart1_rtsn.d_can0_rx", INPUT_PULLUP | MODE2 */
				>;
			};
		};
	};

	fragment@1 {
		target = <&dcan0>;
		__overlay__ {
			status = "okay";
			pinctrl-names = "default";
			pinctrl-0 = <&bone_serl_01_dcan0_pins>;
		};
	};
};

